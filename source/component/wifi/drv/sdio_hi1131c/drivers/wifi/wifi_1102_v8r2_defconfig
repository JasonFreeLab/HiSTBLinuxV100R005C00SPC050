## source/kernel/linux-4.4.y/drivers/hisilicon/misc/Kconfig
```kconfig
config TIMER_HISP804
	bool "Support for hisilicon SP804 module"
	depends on GENERIC_SCHED_CLOCK && CLKDEV_LOOKUP
	select CLKSRC_MMIO
	select CLKSRC_OF if OF

config TIMER_HIFIXTIMER
	bool "Support for fixtimer module"
	depends on ARM_TIMER_SP804 || TIMER_HISP804
	default y

config MTD_BLOCK_ROMBLOCK
	tristate "Readonly(romblock) block device access to MTD devices"
	depends on BLOCK
	select MTD_BLKDEVS
	default y
	help
	  Same as readonly block driver, but this allow you to mount read-only
	  file systems from an MTD device, containing bad blocks.

config PART_CHANGE
	bool "Support change partition by file '/proc/partchange'"
	default y
	select BLK_CMDLINE_PARSER
	select CMDLINE_PARTITION
	---help---
	  Support change partition by file '/proc/partchange'

menu "Hisilicon CPU frequency scaling config"

config MICRO_FREQUENCY_UP_THRESHOLD
	int "Micro frequency up threshold"
	default 80

config DEFAULT_GO_HISPEED_LOAD
	int "Default go hispeed load"
	default 80
	help
	  Go to hi speed when CPU load at or above this value.

config DEFAULT_TARGET_LOAD
	int "Default target load"
	default 70
	help
	  Target load, lower values result in higher CPU speeds.

endmenu

config HI_I2C
	tristate "Hisilicon high-speed I2C devices"
	default n
	depends on I2C
	help
	Say Y here to include support for Hisilicon high-speed I2C controller.

	This driver can also be built as a module.  If so, the module
	will be called hi-i2c.

config PAGEALLOC_LOCK
	bool "lock page when free page, and unlock page when alloc page"
	default n
	select DEBUG_PAGEALLOC
	help
	  for page alloc debug.

menuconfig SUPPORT_DSP_RUN_MEM
        bool "Support DSP run memory"
        default n
        help
          Support DSP run memory

config DSP_RUN_MEM_ADDR
        hex "DSP run memory address"
        depends on SUPPORT_DSP_RUN_MEM
        default "0x2000000"
        help
          The start address of DSP run memory.

config DSP_RUN_MEM_SIZE
        hex "DSP run memory size"
        depends on SUPPORT_DSP_RUN_MEM
        default "0x800000"
        help
          The size of DSP run memory.

menuconfig SUPPORT_ATF_MEM
        bool "Support reserving arm trusted firmware"
        default n
        help
          Support arm trusted firmware

config ATF_MEM_ADDR
        hex "arm trusted firmware memory address"
        depends on SUPPORT_ATF_MEM
        default "0x8020000" if ARCH_HI3796MV2X
	default "0x4400000" if ARCH_HI3798CV2X || ARCH_HI3798MV2X
        help
          The start address of arm trusted firmware.

config ATF_MEM_SIZE
        hex "arm trusted firmware memory size"
        depends on SUPPORT_ATF_MEM
        default "0x200000"
        help
          The size of arm trusted firmware memory.

menuconfig SUPPORT_SMCU_MEM
        bool "Support reserving SMCU memory"
        default n
        help
          Support SMCU memory

config SMCU_MEM_ADDR
        hex "SMCU memory address"
        depends on SUPPORT_SMCU_MEM
        default "0x8000000" if ARCH_HI3796MV2X
        help
          The start address of arm trusted firmware.

config SMCU_MEM_SIZE
        hex "SMCU memory size"
        depends on SUPPORT_SMCU_MEM
        default "0x10000"
        help
          The size of SMCU memory.

config HISI_EXT4_TMP_QUIRK
	bool "Ext4 temp quirk"
	default n
```

## source/kernel/linux-4.4.y/drivers/hisilicon/pcie/Kconfig
```kconfig
menuconfig PCIE_HISILICON
	bool "Hisilicon PCIe controller"
	depends on ARCH_S40 || ARCH_HI3798CV2X || ARCH_HI3798MV2X || ARCH_HI3796MV2X || ARCH_HI3716MV420N
	select PCIEPORTBUS
	select PCIE_DW
	select PCI
	help
	  Say Y here if you want PCIe controller support on HiSilicon HIP05 SoC

config PCIE_PME_IRQ
	hex "Hisilicon PCIe pme interrupt number"
	default "0xa2"	if (ARCH_S40)
	default "0xa2"	if (ARCH_HI3798CV2X)
	default "0xa2"	if (ARCH_HI3798MV2X)
	default "0xa2"	if (ARCH_HI3796MV2X)
	default "0xa2"	if (ARCH_HI3716MV420N)
	depends on PCIE_HISILICON 

config PCIE_DMA_SIZE_READ
	hex "hisilicon pcie dma read size"
	default "0x0" if (ARCH_HI3798CV2X)
	default "0x0" if (ARCH_S40)
	default "0x0" if (ARCH_HI3798MV2X)
	default "0x0" if (ARCH_HI3796MV2X)
	default "0x0" if (ARCH_HI3716MV420N)
	depends on PCIE_HISILICON

config PCIE_DMA_SIZE_WRITE
	hex "hisilicon pcie dma write size"
	default "0x0" if (ARCH_HI3798CV2X)
	default "0x0" if (ARCH_S40)
	default "0x0" if (ARCH_HI3798MV2X)
	default "0x0" if (ARCH_HI3796MV2X)
	default "0x0" if (ARCH_HI3716MV420N)
	depends on PCIE_HISILICON 
```

## source/kernel/linux-4.4.y/drivers/hisilicon/soc/hi3798mv310/Kconfig
```kconfig
config CPU_IDLE_HI3798MV310
	bool "CPU Idle Driver for Hisilicon Hi3798mv310 processors"
	depends on ARCH_HI3798MV310
	help
	  Select this to enable cpuidle on Hi3798mv310 processors.
```

## source/kernel/linux-4.4.y/drivers/hisilicon/tee/Kconfig
```kconfig
menuconfig  TEE
	tristate "Secure TEE driver"
	default n
	help
	 Provides a communication interface between userspace and
	 TrustZone Operating Environment.

config  TEE_HISI
	tristate "Trustedcore Secure TEE driver"
	default n
	depends on TEE
	help
	 Provides a communication interface between userspace and
	 TrustZone Operating Environment.

config  TEE_VMX_ULTRA
	tristate "Trustedcore for vmx ultra"
	default n
	depends on TEE
	help
	  Support for Trustedcore for vmx ultra

config TEE_RESERVED_MEM
	bool "Reserve memory for TEE"
	default n
	depends on TEE
	help
	 Reserve memory for TEE

config TEE_RESERVED_MEM_ADDR
	hex "Reserve memory address for TEE"
	default 0x8000000
	depends on TEE_RESERVED_MEM
	help
	 Reserve memory address for TEE

config TEE_RESERVED_MEM_SIZE
	hex "Reserve memory size for TEE"
	default 0x5800000
	depends on TEE_RESERVED_MEM
	help
	 Reserve memory size for TEE

config ARM32_ATF_SUPPORT
	bool "Support 32bits kernel to send smc to ATF "
	default n
	depends on TEE && (ARCH_HI3798MV310 || ARCH_HI3798CV2X || ARCH_HI3798MV2X)
	help
	 When startup using ATF+32bits Kernel,select this.

if TEE_HISI
source drivers/hisilicon/tee/tee_hisi/tzdriver/Kconfig
endif
```

## source/kernel/linux-4.4.y/drivers/mmc/host/himciv300/Kconfig
```kconfig
#
# himci v300 device configuration
#

config HIMCIV300_SDIO_SYNOPSYS
	tristate "Himciv300 SDIO/MMC device support"
	depends on ARCH_HI3798MV2X || ARCH_HI3796MV2X || ARCH_HI3798MV310
	default n
	select MMC_UNSAFE_RESUME
	select MMC_EMBEDDED_SDIO
	select MMC_BLOCK
	select MMC_BLOCK_BOUNCE
	help
	  This selects the mmc family device.
```

## source/kernel/linux-4.4.y/drivers/mtd/hisilicon/Kconfig
```kconfig
menuconfig MTD_HIFMC100
	tristate "Hisilicon Flash Memory Controller Ver 100 support"
	default n
	select MTD_BLOCK
	help
	  Support Hisilicon Flash Memory Controller Version 100.

if MTD_HIFMC100

config MTD_HIFMC100_SPINOR
	bool "Hisilicon Spi-Nor Flash support"
	default y
	help
	  Support Hisilicon Spi-Nor Flash Memory.

config MTD_HIFMC100_SPINAND
	bool "Hisilicon Spi-Nand Flash support"
	default y
	help
	  Support Hisilicon Spi-Nand Flash Memory.

config MTD_HIFMC100_NAND
	bool "Hisilicon Nand Flash support"
	default y
	help
	  Support Hisilicon Nand Flash Memory.

endif
```

## source/kernel/linux-4.4.y/drivers/net/wireless/mediatek/mt76x2u/Kconfig
```kconfig
config MT76X2U
	tristate "MediaTek MT76X2U (USB) support"
	depends on MAC80211
	depends on USB
	---help---
	  This adds support for MT76X2U-based wireless modules.
```

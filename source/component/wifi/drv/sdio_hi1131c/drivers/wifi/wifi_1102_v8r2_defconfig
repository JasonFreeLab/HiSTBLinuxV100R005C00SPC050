## source/kernel/linux-4.4.y/arch/arm/Kconfig.hisilicon
```kconfig
config ARCH_S40
	bool "Hisilicon S40 family"
	select ARM_AMBA
	select HAVE_CLK
	select CLKDEV_LOOKUP
	select HAVE_SCHED_CLOCK
	select GENERIC_TIME
	select GENERIC_CLOCKEVENTS
	select ARCH_HAS_CPUFREQ
	select MIGHT_HAVE_PCI
	select HAVE_SMP
	select HAVE_ARM_SCU
	select MIGHT_HAVE_CACHE_L2X0
	select NEED_MACH_IO_H
	select NEED_MACH_MEMORY_H
	select ARCH_HAS_CPUFREQ
	select USB_ARCH_HAS_OHCI
	select USB_ARCH_HAS_EHCI
	select USB_ARCH_HAS_XHCI
	select PM_OPP
	help
	  This enables support for Hisilicon S40 platform.
	  With the advanced ARM Cortex A9 processor,
	  S40 serial provides high-speed processing capability.
	  And S40 serial constains a very powerfull media process engine,
	  two ethernet interface, EHCI and OHCI controllers, PCI-Express
	  controller and many peripheral equipments.

config ARCH_HI3716MV420N
	bool "Hisilicon HI3716MV420N family"
	select ARM_AMBA
	select HAVE_CLK
	select CLKDEV_LOOKUP
	select HAVE_SCHED_CLOCK
	select GENERIC_TIME
	select GENERIC_CLOCKEVENTS
	select ARCH_HAS_CPUFREQ
	select MIGHT_HAVE_PCI
	select HAVE_SMP
	select HAVE_ARM_SCU
	select MIGHT_HAVE_CACHE_L2X0
	select NEED_MACH_IO_H
	select NEED_MACH_MEMORY_H
	select ARCH_HAS_CPUFREQ
	select USB_ARCH_HAS_OHCI
	select USB_ARCH_HAS_EHCI
	select USB_ARCH_HAS_XHCI
	select PM_OPP
	help
	  This enables support for Hisilicon HI3716MV420N platform.
	  With the advanced ARM Cortex A9 processor,
	  HI3716MV420N serial provides high-speed processing capability.
	  And HI3716MV420N serial constains a very powerfull media process engine,
	  two ethernet interface, EHCI and OHCI controllers, PCI-Express
	  controller and many peripheral equipments.

config ARCH_HI3798MX
	bool "Hisilicon HI3798MX family"
	select ARM_AMBA
	select HAVE_CLK
	select CLKDEV_LOOKUP
	select HAVE_SCHED_CLOCK
	select GENERIC_TIME
	select GENERIC_CLOCKEVENTS
	select ARCH_HAS_CPUFREQ
	select MIGHT_HAVE_PCI
	select HAVE_SMP
	select NEED_MACH_IO_H
	select NEED_MACH_MEMORY_H
	select ARCH_HAS_CPUFREQ
	select USB_ARCH_HAS_OHCI
	select USB_ARCH_HAS_EHCI
	select USB_ARCH_HAS_XHCI
	select ARM_HAS_SG_CHAIN
	select PM_OPP
	help
	  This enables support for Hisilicon HI3798MX platform.
	  With the advanced ARM Cortex A7 processor,
	  HI3798MX serial provides high-speed processing capability.
	  And HI3798MX serial constains a very powerfull media process engine,
	  two ethernet interface, EHCI and OHCI controllers, PCI-Express
	  controller and many peripheral equipments.

config ARCH_HI3798CV2X
	bool "Hisilicon HI3798CV2X family"
	select ARM_AMBA
	select HAVE_CLK
	select CLKDEV_LOOKUP
	select HAVE_SCHED_CLOCK
	select GENERIC_TIME
	select GENERIC_CLOCKEVENTS
	select ARCH_HAS_CPUFREQ
	select MIGHT_HAVE_PCI
	select HAVE_SMP
	select NEED_MACH_IO_H
	select NEED_MACH_MEMORY_H
	select ARCH_HAS_CPUFREQ
	select USB_ARCH_HAS_OHCI
	select USB_ARCH_HAS_EHCI
	select USB_ARCH_HAS_XHCI
	select ARM_HAS_SG_CHAIN
	select PM_OPP
	help
	  This enables support for Hisilicon HI3798CV2X platform.
	  With the advanced ARM Cortex A17 processor,
	  HI3798CV2X serial provides high-speed processing capability.
	  And HI3798CV2X serial constains a very powerfull media process engine,
	  two ethernet interface, EHCI and OHCI controllers and
	  many peripheral equipments.

config ARCH_HI3798MV2X
	bool "Hisilicon HI3798MV2X family"
	select ARM_AMBA
	select HAVE_CLK
	select CLKDEV_LOOKUP
	select HAVE_SCHED_CLOCK
	select GENERIC_TIME
	select GENERIC_CLOCKEVENTS
	select ARCH_HAS_CPUFREQ
	select MIGHT_HAVE_PCI
	select HAVE_SMP
	select NEED_MACH_IO_H
	select NEED_MACH_MEMORY_H
	select ARCH_HAS_CPUFREQ
	select USB_ARCH_HAS_OHCI
	select USB_ARCH_HAS_EHCI
	select USB_ARCH_HAS_XHCI
	select ARM_HAS_SG_CHAIN
	select PM_OPP
	help
	  This enables support for Hisilicon HI3798MV2X platform.
	  With the advanced ARM Cortex A53 processor,
	  HI3798MV2X serial provides high-speed processing capability.
	  And HI3798MV2X serial constains a very powerfull media process engine,
	  two ethernet interface, EHCI and OHCI controllers and
	  many peripheral equipments.
      
config ARCH_HI3798MV310
	bool "Hisilicon HI3798MV310 family"
	select ARM_AMBA
	select HAVE_CLK
	select CLKDEV_LOOKUP
	select HAVE_SCHED_CLOCK
	select GENERIC_TIME
	select GENERIC_CLOCKEVENTS
	select ARCH_HAS_CPUFREQ
	select MIGHT_HAVE_PCI
	select HAVE_SMP
	select NEED_MACH_IO_H
	select NEED_MACH_MEMORY_H
	select ARCH_HAS_CPUFREQ
	select USB_ARCH_HAS_OHCI
	select USB_ARCH_HAS_EHCI
	select USB_ARCH_HAS_XHCI
	select ARM_HAS_SG_CHAIN
	select PM_OPP
	help
	  This enables support for Hisilicon HI3798MV310 platform.
	  With the advanced ARM Cortex A53 processor,
	  HI3798MV310 serial provides high-speed processing capability.
	  And HI3798MV310 serial constains a very powerfull media process engine,
	  two ethernet interface, EHCI and OHCI controllers and
	  many peripheral equipments.

config ARCH_HI3796MV2X
	bool "Hisilicon HI3796MV2X family"
	select ARM_AMBA
	select HAVE_CLK
	select CLKDEV_LOOKUP
	select HAVE_SCHED_CLOCK
	select GENERIC_TIME
	select GENERIC_CLOCKEVENTS
	select ARCH_HAS_CPUFREQ
	select MIGHT_HAVE_PCI
	select HAVE_SMP
	select NEED_MACH_IO_H
	select NEED_MACH_MEMORY_H
	select ARCH_HAS_CPUFREQ
	select USB_ARCH_HAS_OHCI
	select USB_ARCH_HAS_EHCI
	select USB_ARCH_HAS_XHCI
	select ARM_HAS_SG_CHAIN
	select PM_OPP
	help
	  This enables support for Hisilicon HI3796MV2X platform.
	  With the advanced ARM Cortex A53 processor,
	  HI3798MV2X serial provides high-speed processing capability.
	  And HI3796MV2X serial constains a very powerfull media process engine,
	  two ethernet interface, EHCI and OHCI controllers and
```

## source/kernel/linux-4.4.y/arch/arm/mach-hi3716mv420n/Kconfig
```kconfig
if ARCH_HI3716MV420N
menu "Hi3716MV420N board feature"

config MACH_HI3716MV420N
	bool "Support Hi3716MV420N platform"
	select CPU_V7
	select ARM_GIC
	select ARM_TIMER_SP804
	select COMMON_CLK
	select ARCH_REQUIRE_GPIOLIB
	select DYNAMIC_DEBUG
	help
	  Include support for the hisilion Hi3716MV420N platform.
	  Hi3716MV420N support ARM CORTEX-A9 processer,
	  within a Generic Interrupt Controller.
	  Support DDR2 and DDR3.

config DEFAULT_UART_BASE_ADDR
	hex "Default uart controller base address"
	default "0xF8B00000"
	help
	  Default UART controller base address

config DEFAULT_VMALLOC_SIZE
	int "Default vmalloc size"
	default 240
	help
	  Default vmalloc size in MBytes. Use "vmalloc=size" to change it.

config MMZ_PARAM
	string "MMZ param for CMA and ION"
	depends on CMA
	default "ddr,0,0,320M" if MACH_HI3716MV420N
	help
	  This is the parameter of mmz memory manager, which now is for CMA 
	  and ION memory manager.

endmenu
endif
```

## source/kernel/linux-4.4.y/arch/arm/mach-hi3796mv2x/Kconfig
```kconfig
if ARCH_HI3796MV2X
menu "HI3796MV2X board feature"

config MACH_HI3796MV2X
	bool "Support hi3796mv2x platform"
	select CPU_V7
	select ARM_GIC
	select ARM_TIMER_SP804
	select COMMON_CLK
	select ARCH_REQUIRE_GPIOLIB
	select DYNAMIC_DEBUG if !CA_SUPPORT_ADVCA || DEBUG_FS && PRINTK
	help
	  Include support for the hisilion HI3796MV2X platform.
	  HI3796MV2X support ARM CORTEX-A7 processer,
	  within a Generic Interrupt Controller.
	  Support DDR2 and DDR3.

config DEFAULT_UART_BASE_ADDR
	hex "Default uart controller base address"
	default "0xF8B00000"
	help
	  Default UART controller base address

config DEFAULT_VMALLOC_SIZE
	int "Default vmalloc size"
	default 240
	help
	  Default vmalloc size in MBytes. Use "vmalloc=size" to change it.

config HI3796MV2X_FPGA
	bool "Enable HI3796MV2X Fpga config"
	default n if ARCH_HI3796MV2X

endmenu
endif
```

## source/kernel/linux-4.4.y/arch/arm/mach-hi3798cv2x/Kconfig
```kconfig
if ARCH_HI3798CV2X
menu "HI3798CV2X board feature"

config MACH_HI3798CV2X
	bool "Support hi3798cv2x platform"
	select CPU_V7
	select ARM_GIC
	select ARM_TIMER_SP804
	select COMMON_CLK
	select ARCH_REQUIRE_GPIOLIB
	select DYNAMIC_DEBUG
	help
	  Include support for the hisilion HI3798CV2X platform.
	  HI3798CV2X support ARM CORTEX-A7 processer,
	  within a Generic Interrupt Controller.
	  Support DDR2 and DDR3.

config DEFAULT_UART_BASE_ADDR
	hex "Default uart controller base address"
	default "0xF8B00000"
	help
	  Default UART controller base address

config DEFAULT_VMALLOC_SIZE
	int "Default vmalloc size"
	default 240
	help
	  Default vmalloc size in MBytes. Use "vmalloc=size" to change it.

config HI3798CV2X_FPGA
	bool "Enable HI3798CV2X Fpga config"
	default n if ARCH_HI3798CV2X

endmenu
endif
```

## source/kernel/linux-4.4.y/arch/arm/mach-hi3798mv2x/Kconfig
```kconfig
if ARCH_HI3798MV2X
menu "HI3798MV2X board feature"

config MACH_HI3798MV2X
	bool "Support hi3798mv2x platform"
	select CPU_V7
	select ARM_GIC
	select ARM_TIMER_SP804
	select COMMON_CLK
	select ARCH_REQUIRE_GPIOLIB
	select DYNAMIC_DEBUG
	help
	  Include support for the hisilion HI3798MV2X platform.
	  HI3798MV2X support ARM CORTEX-A7 processer,
	  within a Generic Interrupt Controller.
	  Support DDR2 and DDR3.

choice
	prompt "CPU timer source"
	default HAVE_SP804_LOCAL_TIMER_HI3798MV2X

config HAVE_SP804_LOCAL_TIMER_HI3798MV2X
	bool "arm local timer from sp804"
	help
	  arm local timer from sp804.

config HAVE_ARM_LOCAL_TIMER_HI3798MV2X
	bool "arm local timer from arm self"
	help
	  arm local timer from arm self.
endchoice

config DEFAULT_UART_BASE_ADDR
	hex "Default uart controller base address"
	default "0xF8B00000"
	help
	  Default UART controller base address

config DEFAULT_VMALLOC_SIZE
	int "Default vmalloc size"
	default 500
	help
	  Default vmalloc size in MBytes. Use "vmalloc=size" to change it.

config HI3798MV2X_FPGA
	bool "Enable HI3798MV2X Fpga config"
	default n if ARCH_HI3798MV2X

endmenu
endif
```

## source/kernel/linux-4.4.y/arch/arm/mach-hi3798mx/Kconfig
```kconfig
if ARCH_HI3798MX
menu "HI3798MX board feature"

config MACH_HI3798MX
	bool "Support hi3798mx platform"
	select CPU_V7
	select ARM_GIC
	select COMMON_CLK
	select ARCH_REQUIRE_GPIOLIB
	select DYNAMIC_DEBUG
	help
	  Include support for the hisilion HI3798MX platform.
	  HI3798MX support ARM CORTEX-A7 processer,
	  within a Generic Interrupt Controller.
	  Support DDR2 and DDR3.

config DEFAULT_UART_BASE_ADDR
	hex "Default uart controller base address"
	default "0xF8B00000"
	help
	  Default UART controller base address

config DEFAULT_VMALLOC_SIZE
	int "Default vmalloc size"
	default 240
	help
	  Default vmalloc size in MBytes. Use "vmalloc=size" to change it.

endmenu
endif
```

## source/kernel/linux-4.4.y/arch/arm/mach-s40/Kconfig
```kconfig
if ARCH_S40
menu "S40 board feature"

config MACH_S40
	bool "Support s40 platform"
	select CPU_V7
	select ARM_GIC
	select ARM_TIMER_SP804
	select COMMON_CLK
	select ARCH_REQUIRE_GPIOLIB
	select DYNAMIC_DEBUG
	help
	  Include support for the hisilion S40 platform.
	  S40 support ARM CORTEX-A9 processer,
	  within a Generic Interrupt Controller.
	  Support DDR2 and DDR3.

config DEFAULT_UART_BASE_ADDR
	hex "Default uart controller base address"
	default "0xF8B00000"
	help
	  Default UART controller base address

config DEFAULT_VMALLOC_SIZE
	int "Default vmalloc size"
	default 240
	help
	  Default vmalloc size in MBytes. Use "vmalloc=size" to change it.

config MMZ_PARAM
	string "MMZ param for CMA and ION"
	depends on CMA
	default "ddr,0,0,320M" if MACH_S40
	help
	  This is the parameter of mmz memory manager, which now is for CMA 
	  and ION memory manager.

endmenu
endif
```

## source/kernel/linux-4.4.y/arch/arm64/Kconfig.hisilicon
```kconfig
config ARCH_HI3798CV2X
	bool "Hisilicon Hi3798Cv200 family"
	select ARM_HAS_SG_CHAIN
	select PM_OPP
	help
	  This enables support for Hisilicon Hi3798Cv200 platform.

config ARCH_HI3798MV2X
	bool "Hisilicon Hi3798Mv200 family"
	select ARM_HAS_SG_CHAIN
	select PM_OPP
	help
	  This enables support for Hisilicon Hi3798Mv200 platform.

config HI3798MV2X_FPGA
	bool "Enable HI3798MV2X Fpga config"
	default n if ARCH_HI3798MV2X

config ARCH_HI3796MV2X
       bool "Hisilicon Hi3796Mv200 family"
       select ARM_HAS_SG_CHAIN
       select PM_OPP
       help
         This enables support for Hisilicon Hi3796Mv200 platform.
```

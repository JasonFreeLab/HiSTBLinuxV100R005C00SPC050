## scripts/kconfig/Kconfig.tee
```kconfig
config HI_TEE_SUPPORT
    bool "TEE Support"
    depends on !(HI3716MV410 || HI3716MV420)
    default n
    help
        Support trust execution environment enables you to use secure os and memory.
        You should say n here, unless you really know what are you doing.
        Say yes here can get tee.

choice
    prompt "TEE Memory Layout"
    depends on HI_TEE_SUPPORT && (HI3798MV100 || HI3796MV100 || HI3716DV100 || HI3798CV200 || HI3798MV200 || HI3798MV300)
    default 1G

config  TVP_MEM_512M
    bool "512M"
    depends on HI3716DV100
config  TVP_MEM_1G
    bool "1G"
config  TVP_MEM_1_5G
    bool "1.5G"
    depends on !(HI3798MV100 || HI3796MV100 || HI3716DV100)
config  TVP_MEM_2G
    bool "2G"
endchoice

config  HI_TVP_MEM_LAYOUT
    string
    depends on HI_TEE_SUPPORT && (HI3798MV100 || HI3796MV100 || HI3716DV100 || HI3798CV200 || HI3798MV200 || HI3798MV300)
    default 512M    if TVP_MEM_512M
    default 1G      if TVP_MEM_1G
    default 1_5G    if TVP_MEM_1_5G
    default 2G      if TVP_MEM_2G

menu "TEE Module List"
    depends on HI_TEE_SUPPORT

menuconfig  HI_TEE_VFMW_SUPPORT
    bool "VFMW Support"
    depends on HI_TEE_SUPPORT
    default y

menuconfig  HI_TEE_KLAD_SUPPORT
    bool "KLAD Support"
    depends on HI_TEE_SUPPORT
    default y

menuconfig  HI_TEE_PVR_SUPPORT
    bool "PVR Support"
    depends on HI_TEE_SUPPORT && !(HI3798MV100 || HI3796MV100 || HI3716DV100)
    default y

menuconfig  HI_TEE_DEMUX_SUPPORT
    bool "Demux Support"
    depends on HI_TEE_SUPPORT
    default y

menuconfig  HI_TEE_PLCIPHER_SUPPORT
    bool "Plcipher Support"
    depends on HI_TEE_SUPPORT && HI3796MV200
    default y

menuconfig  HI_TEE_HDMI_SUPPORT
    bool "HDMI Support"
    depends on HI_TEE_SUPPORT && !(HI3798MV100 || HI3796MV100 || HI3716DV100)
    default y

menuconfig  HI_TEE_DEMO_SUPPORT
    bool "DEMO Support"
    depends on HI_TEE_SUPPORT
    default n

menuconfig  HI_TEE_TEST_SUPPORT
    bool "Test Support"
    depends on HI_TEE_SUPPORT
    default n

menuconfig  HI_TEE_TA_LOAD_SUPPORT
    bool "Ta Dynamic Load Support"
    depends on HI_TEE_SUPPORT
    default n

menuconfig  HI_TEE_PM_SUPPORT
    bool "Power Manager Support"
    depends on HI_TEE_SUPPORT
    default n

menuconfig  HI_TEE_VDP_SUPPORT
    bool "VDP Support"
    depends on HI_TEE_SUPPORT && !(HI3798MV100 || HI3796MV100 || HI3716DV100)
    default y

menuconfig  HI_TEE_BEIDOU_SUPPORT
    bool "Beidou Support"
    depends on HI_TEE_SUPPORT && HI3716DV100
    default y

menuconfig  HI_TEE_I2C_SUPPORT
    bool "I2C driver Support"
    depends on HI_TEE_SUPPORT && HI3716DV100
    default y

menuconfig  HI_TEE_WIDEVINE_SUPPORT
    bool "Widevine Support"
    depends on HI_TEE_SUPPORT && !(HI3798MV100 || HI3796MV100 || HI3716DV100)
    default y

menuconfig  HI_TEE_PLAYREADY_SUPPORT
    bool "PlayReady Support"
    depends on HI_TEE_SUPPORT && !(HI3798MV100 || HI3796MV100 || HI3716DV100)
    default y

menuconfig  HI_TEE_VMX_ULTRA_SUPPORT
    bool "Verimatrix Ultra Support"
    depends on HI_TEE_SUPPORT && ADVCA_VERIMATRIX_ULTRA && !(HI3798MV100 || HI3796MV100 || HI3716DV100)
    default y

menuconfig  HI_TEE_SUMA_SUPPORT
    bool "Suma Cardless Support"
    depends on ADVCA_SUMA && HI_TEE_SUPPORT && (HI3798MV200 || HI3798MV300)
    default n
	
config  HI_TEE_VMXTAC_TEST_SUPPORT
    bool "VMXTAC TEST Support"
    depends on HI_TEE_SUPPORT && HI_TEE_VMX_ULTRA_SUPPORT
    default n

config HI_TEE_ITAC_TEST_SUPPORT
    bool "ITAC TEST Support"
    depends on HI_TEE_SUPPORT && HI_TEE_VMX_ULTRA_SUPPORT
    default n

config  HI_TEE_CRYPTOEN_SUPPORT
    bool "Nagra Crypto Engine Support"
    depends on HI_TEE_SUPPORT && (HI3796MV200)
    default n
config HI_TEE_MCU_SUPPORT
    bool "MCU Support"
    depends on HI_TEE_SUPPORT && HI_TEE_VMX_ULTRA_SUPPORT && (HI3798MV200)
    default y

config HI_TEE_PM_SUPPORT
    bool "PMOC Support"
    depends on HI_TEE_SUPPORT && (HI3796MV200)
    default y
endmenu
```

## scripts/kconfig/Kconfig.tsio
```kconfig
#+++++++++++++++++++++++++++++++++++++++++++++++++++

menuconfig HI_TSIO_SUPPORT
	bool "TSIO Support"
	depends on HI3796MV200
	default n

menu "TSIO PHY support"
	depends on HI_TSIO_SUPPORT

choice
	prompt "mode"
	default HI_TSIO_PHY_NORMAL_SUPPORT

config HI_TSIO_PHY_NORMAL_SUPPORT
	bool "normal"
	help
	  The optimal phy configuration value may change for different chip and board.

config HI_TSIO_PHY_LOOPBACK_SUPPORT
	bool "loopback"

endchoice

menu "12.5MHz"
	depends on HI_TSIO_PHY_NORMAL_SUPPORT

config HI_TSIO_PHY_12MHZ_OFFSET
	prompt "offset"
	int
	default 110

config HI_TSIO_PHY_12MHZ_SWING
	prompt "swing"
	int
	default 100

config HI_TSIO_PHY_12MHZ_PRE_EMPHASIS
	prompt "pre-emphasis"
	int
	default 0

config HI_TSIO_PHY_12MHZ_SLEW
	prompt "slew"
	int
	default 3

config HI_TSIO_PHY_12MHZ_SKEW
	prompt "skew"
	int
	default 0

endmenu

menu "25MHz"
	depends on HI_TSIO_PHY_NORMAL_SUPPORT

config HI_TSIO_PHY_25MHZ_OFFSET
	prompt "offset"
	int
	default 110

config HI_TSIO_PHY_25MHZ_SWING
	prompt "swing"
	int
	default 100

config HI_TSIO_PHY_25MHZ_PRE_EMPHASIS
	prompt "pre-emphasis"
	int
	default 0

config HI_TSIO_PHY_25MHZ_SLEW
	prompt "slew"
	int
	default 3

config HI_TSIO_PHY_25MHZ_SKEW
	prompt "skew"
	int
	default 0

endmenu

menu "50MHz"
	depends on HI_TSIO_PHY_NORMAL_SUPPORT

config HI_TSIO_PHY_50MHZ_OFFSET
	prompt "offset"
	int
	default 110

config HI_TSIO_PHY_50MHZ_SWING
	prompt "swing"
	int
	default 100

config HI_TSIO_PHY_50MHZ_PRE_EMPHASIS
	prompt "pre-emphasis"
	int
	default 0

config HI_TSIO_PHY_50MHZ_SLEW
	prompt "slew"
	int
	default 3

config HI_TSIO_PHY_50MHZ_SKEW
	prompt "skew"
	int
	default 0

endmenu

menu "100MHz"
	depends on HI_TSIO_PHY_NORMAL_SUPPORT

config HI_TSIO_PHY_100MHZ_OFFSET
	prompt "offset"
	int
	default 110

config HI_TSIO_PHY_100MHZ_SWING
	prompt "swing"
	int
	default 100

config HI_TSIO_PHY_100MHZ_PRE_EMPHASIS
	prompt "pre-emphasis"
	int
	default 0

config HI_TSIO_PHY_100MHZ_SLEW
	prompt "slew"
	int
	default 2

config HI_TSIO_PHY_100MHZ_SKEW
	prompt "skew"
	int
	default 0

endmenu

endmenu

#+++++++++++++++++++++++++++++++++++++++++++++++++++
```

## scripts/kconfig/Kconfig.wifi
```kconfig
#+++++++++++++++++++++++++++++++++++++++++++++++++++
#--------------------------------
menuconfig HI_WIFI_SUPPORT
	bool "WiFi Support"
	default n
	depends on LINUX_PRODUCT
	help
	  This section contains all the supported 802.11 wireless device drivers.
	  Set to 'y' to support this device, 'n' not support.

menu    "WiFi Device Type"
	depends on HI_WIFI_SUPPORT

config  HI_WIFI_DEVICE_HI1131C
	bool "HI1131C (11n 1x1 2.4G SDIO)"
	depends on ((HI3798MV200 || HI3798MV300 || HI3798MV310) && HI_32BIT_SYSTEM)

config  HI_WIFI_DEVICE_RTL8188EUS
	bool "Realtek RTL8188ETV and RTL8188EUS (11n 1x1 2.4G USB)"

config  HI_WIFI_DEVICE_RTL8192EU
	bool "Realtek RTL8192EU (11n 2x2 2.4G USB)"
	depends on ((HI3798CV200 && HI_32BIT_SYSTEM) || ((HI3798MV200 || HI3798MV300 || HI3798MV310) && HI_32BIT_SYSTEM))

config  HI_WIFI_DEVICE_RTL8188FU
	bool "Realtek RTL8188FTV(11n 1x1 2.4G USB)"
	depends on (HI3798MV100 || HI3796MV100 || HI3716DV100 || (HI3798CV200 && HI_32BIT_SYSTEM) || ((HI3798MV200 || HI3798MV300 || HI3798MV310) && HI_32BIT_SYSTEM))

config  HI_WIFI_DEVICE_RTL8812AE
	bool "Realtek RTL8812AE (11ac 2x2 2.4G+5G PCIE)"
	depends on (HI3716MV410 || HI3716MV420)

config  HI_WIFI_DEVICE_RTL8812AU
	bool "Realtek RTL8812AU (11ac 2x2 5G USB)"
	depends on ((HI3798CV200 && HI_32BIT_SYSTEM) || ((HI3798MV200 || HI3798MV300 || HI3798MV310) && HI_32BIT_SYSTEM))

config  HI_WIFI_DEVICE_RTL8723BU
	bool "Realtek RTL8723BU (11n 1x1 2.4G USB + BT4.0)"
	depends on ((HI3798CV200 && HI_32BIT_SYSTEM) || ((HI3798MV200 || HI3798MV300 || HI3798MV310) && HI_32BIT_SYSTEM))

config  HI_WIFI_DEVICE_RTL8822BU
	bool "Realtek RTL8822BU (11ac 2x2 5G USB)"
	depends on ((HI3798CV200 && HI_32BIT_SYSTEM) || ((HI3798MV200 || HI3798MV300 || HI3798MV310) && HI_32BIT_SYSTEM))

config  HI_WIFI_DEVICE_RTL8822BS
	bool "Realtek RTL8822BS (11ac 2x2 5G SDIO)"
	depends on ((HI3798CV200 && HI_32BIT_SYSTEM) || ((HI3798MV200 || HI3798MV300 || HI3798MV310) && HI_32BIT_SYSTEM))

config  HI_WIFI_DEVICE_RTL8821AU
	bool "Realtek RTL8821AU (11ac 1x1 5G USB + BT4.0)"
	depends on ((HI3798CV200 && HI_32BIT_SYSTEM))

config  HI_WIFI_DEVICE_MT76X2U
	bool "Mediatek MT7662TU and MT7632TU (2x2 USB + BT4.0)"
	depends on (HI3798MV100 || HI3796MV100 || HI3716DV100 || (HI3798CV200 && HI_32BIT_SYSTEM) || ((HI3798MV200 || HI3798MV300 || HI3798MV310) && HI_32BIT_SYSTEM))

config  HI_WIFI_DEVICE_MT7662TE
	bool "Mediatek MT7662TE (11ac 2x2 5G PCIE + BT4.0)"
	depends on ((HI3798CV200 && HI_32BIT_SYSTEM) || ((HI3798MV200 || HI3798MV300 || HI3798MV310) && HI_32BIT_SYSTEM) || (HI3796MV200 && HI_32BIT_SYSTEM))

config  HI_WIFI_DEVICE_AP6356S
	bool "AP6356S (11ac 2x2 5G SDIO + BT4.0 UART)"
	depends on ((HI3798MV200 || HI3798MV300 || HI3798MV310) && HI_32BIT_SYSTEM)

config  HI_WIFI_DEVICE_RTL8822BEH
	bool "Realtek RTL8822BEH (11ac 2x2 2.4G+5G PCIE, BT UART)"
	depends on ((HI3798CV200 && HI_32BIT_SYSTEM) || ((HI3798MV200 || HI3798MV300 || HI3798MV310) && HI_32BIT_SYSTEM)|| (HI3796MV200 && HI_32BIT_SYSTEM))

#config  HI_WIFI_DEVICE_MT7601U
#	bool "Mediatek MT7601U (11n 1x1 2.4G USB)"
#	depends on (HI3798MV100 || HI3796MV100 || HI3716DV100)

#config  HI_WIFI_DEVICE_RT5572
#	bool "Mediatek RT5572 (11n 2x2 2.4G+5G USB)"
#	depends on (HI3798MV100 || HI3796MV100 || HI3716DV100)

endmenu

menu	"WiFi Working Mode"
	depends on HI_WIFI_SUPPORT

config  HI_WIFI_MODE_STA
	bool "STA Mode"

config  HI_WIFI_MODE_AP
	bool "SoftAP Mode"
endmenu
```

## source/component/wifi/drv/pcie_rtl8812ar/rtl8812AE_linux_v5.1.5_22119.20170509_COEX20170308-003b01/Kconfig
```kconfig
config RTL8812AE
	tristate "Realtek 8812A PCI WiFi"
	depends on PCI
	---help---
	  Help message of RTL8812AE
```

## source/component/wifi/drv/sdio_hi1131c/Kconfig
```kconfig
#
#Generic huawei hisi misc drivers configuration
#
menuconfig CONNECTIVITY_HI110X
	bool "Hisilicon Wireless Connectivity Support"
	default y
	---help---
		If you want to use Hisilicon  Wireless Connectivity, you should set this,
		and choose one product
 
if CONNECTIVITY_HI110X
config HI110X_DRIVER_PATH
	string "The Kernel Driver Path"
	default "drivers/wifi/sdio_hi1131c/drivers"

config HI1131_HI3798MV2X
  bool "Hisilicon 1131 adapt hi3798mv2x"
  default y
  
config HAS_WAKELOCK
  bool "Hisilicon 1131 wakelock"
  default y	  
 
config DEV_CLK_40M
  bool "provide 40M clk to 1131c chip"
  default n

source "drivers/wifi/sdio_hi1131c/drivers/Kconfig"
source "drivers/wifi/sdio_hi1131c/drivers/platform/Kconfig"
source "drivers/wifi/sdio_hi1131c/drivers/wifi/Kconfig"
endif
```

## source/component/wifi/drv/sdio_hi1131c/drivers/Kconfig
```kconfig
#
# Generic huawei hisi misc drivers configuration
#
config HI110X_SDIO_STD_CARD_SUPPORT
	bool
	default n

config HI110X_SDIO_FPGA
	bool
	default y

config HI110X_SDIO_NON_STD_CARD_SUPPORT
	bool
	default y
	depends on !HI110X_SDIO_STD_CARD_SUPPORT

config HI110X_SDIO_DETECT_FUNCTION
	bool
	default y
```

## source/component/wifi/drv/sdio_hi1131c/drivers/platform/Kconfig
```kconfig
menuconfig HI1102_PLATFORM
	tristate "Hisilicon Wireless Connectivity Platform Module"
	depends on CONNECTIVITY_HI110X
	default m
	---help---
		If you want to use Hisilicon  Wireless Connectivity,first choose this.
		
if HI1102_PLATFORM

config HI1102_PLAT_HW_CHR
  bool "Hisilicon 1102 platform chr log"
  depends on !HI1131_HI3798MV2X
  default y
  ---help---
	Hisilicon 1102 platform chr log

config HI1102_PLAT_OAL
  bool "Hisilicon 1102 platform oal module"
  default y
  select HI110X_SDIO_STD_CARD_SUPPORT
  select HI110X_SDIO_DETECT_FUNCTION
  ---help---
	Hisilicon 1102 platform oal module
  
config HI1102_PLAT_FRW
  bool "Hisilicon 1102 platform framework module"
  default y
  ---help---
	Hisilicon 1102 platform oal module
	
config HI1102_PLAT_OAM
  bool "Hisilicon 1102 platform oam module"
  default y
  ---help---
	Hisilicon 1102 platform oam module
	
config HI1102_PLAT_SDT
  bool "Hisilicon 1102 platform sdt module"
  default y
  ---help---
	Hisilicon 1102 platform sdt module
	
config HI1102_PLAT_PS
  bool "Hisilicon 1102 platform ps module"
  default y
  ---help---
	Hisilicon 1102 platform ps module
	
config HI1102_PLAT_PM
  bool "Hisilicon 1102 platform power manager module"
  default y
  ---help---
	Hisilicon 1102 platform power manager module
	
config HI1102_PLAT_MAIN
  bool "Hisilicon 1102 platform main module"
  default y
  ---help---
	Hisilicon 1102 platform main module
	
endif
```

## source/component/wifi/drv/sdio_hi1131c/drivers/wifi/Kconfig
```kconfig
menuconfig HI1102_WIFI
	tristate "Hisilicon Wireless Connectivity WiFi Module"
	depends on CONNECTIVITY_HI110X && WIRELESS && CFG80211
	select WIRELESS_EXT
	select WEXT_SPY
	select WEXT_PRIV
	default m
	---help---
		If you want to use Hisilicon  Wireless Connectivity,first choose this.
		
if HI1102_WIFI
config HI1102_WIFI_HMAC
  bool "Hisilicon 1102 wifi hmac module"
  default y
  ---help---
	Hisilicon 1102 wifi hmac module
  
config HI1102_WIFI_WAL
  bool "Hisilicon 1102 wifi wal module"
  default y
  ---help---
	Hisilicon 1102 wifi wal module
	
config HI1102_WIFI_MAIN
  bool "Hisilicon 1102 wifi main module"
  default y
  ---help---
	Hisilicon 1102 wifi main module
	
config HI1102_WIFI_DMAC
  bool "Hisilicon 1102 wifi dmac module"
  default n
  ---help---
	Hisilicon 1102 wifi dmac module
	
endif
```

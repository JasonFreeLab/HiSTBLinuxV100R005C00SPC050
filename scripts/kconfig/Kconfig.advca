## scripts/kconfig/Kconfig.advca
```kconfig
#+++++++++++++++++++++++++++++++++++++++++++++++++++
menuconfig HI_ADVCA_SUPPORT
	bool "Advance CA Support"
	default n
#--------------------------------
choice
	prompt "Advance CA Type"
	depends on HI_ADVCA_SUPPORT
	default ADVCA_OTHER
config  ADVCA_CONAX
	bool "Conax"
config  ADVCA_NOVEL
	bool "Novel"
config  ADVCA_NAGRA
	bool "Nagra"
	select HI_TSIO_SUPPORT if HI3796MV200
config  ADVCA_SUMA
	bool "Suma"
config  ADVCA_CTI
	bool "Cti"
config  ADVCA_VERIMATRIX
	bool "Verimatrix"
config  ADVCA_IRDETO
	bool "Irdeto"
config  ADVCA_PANACCESS
	bool "Panaccess"
config  ADVCA_DCAS
	bool "Dcas"
config  ADVCA_OTHER
	bool "Other"
endchoice

choice
	prompt "Verimatrix Type"
	depends on  ADVCA_VERIMATRIX && HI_ADVCA_SUPPORT
config  ADVCA_VERIMATRIX_ADVANCE
	bool "Advanced"
config  ADVCA_VERIMATRIX_ULTRA
	bool "Ultra"
endchoice 

menu "fbl parameters config"
	depends on ADVCA_VERIMATRIX_ULTRA && ADVCA_VERIMATRIX && HI_ADVCA_SUPPORT
	
	config HI_FBL_OEM_RSA_PUB_KEY
	prompt "OEM RSA Public key(512 Bytes)"
	string
	depends on ADVCA_VERIMATRIX_ULTRA && ADVCA_VERIMATRIX && HI_ADVCA_SUPPORT
	help
	    it's used to verify "Ext Params Area", when chipset is Ultra, it's used to verify SBL image also.
	
	config HI_FBL_SWPK_OEM_KEY
	prompt "Encrypted SWPK_OEM(16 bytes)"
	string
	depends on ADVCA_VERIMATRIX_ULTRA && ADVCA_VERIMATRIX && HI_ADVCA_SUPPORT
	help
	    it's used to decrypt SBL image, only for Ultra chipset.
	
	config HI_SECURE_OS_PARITITION_SIZE
	hex "Secure OS paritition size"
	depends on ADVCA_VERIMATRIX_ULTRA && ADVCA_VERIMATRIX && HI_ADVCA_SUPPORT
	default 0x800000

	config HI_SBL_PARITITION_SIZE
	hex "SBL paritition size"
	depends on ADVCA_VERIMATRIX_ULTRA && ADVCA_VERIMATRIX && HI_ADVCA_SUPPORT
	default 0x400000

	config HI_FBL_DATA_PARITITION_SIZE
	hex "FBL data paritition size"
	depends on ADVCA_VERIMATRIX_ULTRA && ADVCA_VERIMATRIX && HI_ADVCA_SUPPORT
	default 0x800000

	config HI_SBL_VERIFY_FLAG
	bool "SBL Verify Flag"
	depends on ADVCA_VERIMATRIX_ULTRA && ADVCA_VERIMATRIX && HI_ADVCA_SUPPORT
	default n
	help
	    if the SBL image is signed, but no need to verify, say n; otherwise the SBL image should be verified

	config HI_SBL_DECRYPT_FLAG
	bool "SBL Decrypt Flag"
	depends on ADVCA_VERIMATRIX_ULTRA && ADVCA_VERIMATRIX && HI_ADVCA_SUPPORT && (HI_SBL_VERIFY_FLAG=y)
	default n
	help
	    if the SBL image is not encrypted, say n; otherwise the SBL image is encrypted. this is valid when SBL Verify Flag is y.
endmenu
 
config  HI_ADVCA_TYPE
	string
	depends on HI_ADVCA_SUPPORT
	default CONAX           if ADVCA_CONAX
	default NOVEL           if ADVCA_NOVEL
	default NAGRA           if ADVCA_NAGRA
	default SUMA            if ADVCA_SUMA
	default CTI             if ADVCA_CTI
	default VERIMATRIX      if ADVCA_VERIMATRIX_ADVANCE
	default VERIMATRIX_ULTRA     if ADVCA_VERIMATRIX_ULTRA
	default IRDETO		if ADVCA_IRDETO
	default PANACCESS	if ADVCA_PANACCESS
	default DCAS		if ADVCA_DCAS
	default OTHER           if ADVCA_OTHER
#--------------------------------


menuconfig ADVCA_FUNCTION
	bool "Advance CA Function"
	depends on HI_ADVCA_SUPPORT
	default n
	help
	  From now on,this option is only for Nagra and Conax CA.Some functions of SDK are disabled,especially those for debugging.

choice
	prompt "Advca Function"
	depends on ADVCA_FUNCTION
config  FUNCTION_RELEASE
	bool "RELEASE"
	help
	  With this option selected,SDK can meets some security requirements of advanced CA listed below.
	  1.Useless drivers,modules and libraries are not allowed to be compiled.
	  2.Modules in kernel are not unloadable.
	  3.NFS is not supported.
	  4.No debugging method is supported.No debugging information outputs.
	  5.No user can log into system through shell.
config  FUNCTION_DEBUG
	bool "DEBUG"
	help
	  With this option selected,functions below are added to FINAL version.
	  1.Allow communication through UART.
	  2.Allow user to log into system.
	  3.Allow user to run apps in command line.
endchoice

config  HI_ADVCA_FUNCTION
	string
	depends on ADVCA_FUNCTION
	default DEBUG       if FUNCTION_DEBUG
	default RELEASE     if FUNCTION_RELEASE

config HI_STATIC_LIB_ONLY
	bool
	default y
	depends on ADVCA_FUNCTION

config HI_ADVCA_VERIFY_ENABLE
    bool "Advca verify enable"
    depends on HI_ADVCA_SUPPORT
    help
      If you want to enable boot to verify other images (kernel,loader,rootfs and so on), say y.

config HI_ADVCA_VMX_3RD_SIGN
    bool "Verimatrix Third-Party Sign Solution"
    depends on (HI_ADVCA_SUPPORT && ADVCA_VERIMATRIX_ADVANCE)
	default n
    help
      If you want to enable verimatrix third-party signing solution, say y.

config HI_ADVCA_USE_EXT1_RSA_KEY
    bool "Verify with ext1_rsa_key"
    depends on HI_ADVCA_SUPPORT && ADVCA_CONAX
    default n
    help
      If the boot verify other images (kernel,loader,rootfs and so on) with the ext1_rsa_key which is stored in the key area of signed boot image, say y.
      If this option is not selected, the boot will verify other images with the ext2_rsa_key in bootcode.
      Please refer to source/boot/product/driver/advca/common/auth/ca_config.c for ext2_rsa_key.

#--------------------------------
menuconfig HI_ADVCA_SANDBOX_SUPPORT
	bool "Support Advance CA Sandbox"
	depends on HI_ADVCA_SUPPORT
	default y
	
choice
	prompt "CA Sandbox Type"
	depends on HI_ADVCA_SANDBOX_SUPPORT
	default SANDBOX_LXC
config  SANDBOX_CHROOT
	bool "Chroot"
	depends on HI_LOADER_APPLOADER
config  SANDBOX_LXC
	bool "LXC"
	depends on !HI_LOADER_APPLOADER

endchoice

config  HI_ADVCA_SANDBOX_TYPE
	string
	depends on HI_ADVCA_SANDBOX_SUPPORT
	default CHROOT        if SANDBOX_CHROOT
	default LXC           if SANDBOX_LXC

#--------------------------------
```

## scripts/kconfig/Kconfig.avplay
```kconfig
#++++++++++++++++++++++++++++++++++++++++++++++++++++
menu "Avplay Config"
        depends on (HI3716MV410 || HI3716MV420 || HI3798MV200 || HI3798MV300 || HI3798MV310)

#--------------------------------
config HI_AVPLAY_PLAY_AND_REC_SUPPORT
        bool "Avplay Play And Rec On A Demux Support"
        default n

endmenu
#++++++++++++++++++++++++++++++++++++++++++++++++++++
```

## scripts/kconfig/Kconfig.board.pcie
```kconfig
menu "PCIe Config"
    depends on HI3798CV200 || HI3798MV200 || HI3798MV300 || HI3798MV200_A || HI3796MV200

config  HI_PCIE_SUPPORT
    bool
    default y
    depends on HI3798CV200 || HI3798MV200 || HI3798MV300 || HI3798MV200_A || HI3796MV200

config  HI_GPIO_PCIE_RESET
    hex "PCIe Reset GPIO Number"
    default 0xff
    depends on HI_PCIE_SUPPORT
    help
      pcie reset gpio
      gpio_pin (gpio_pin = gpio_group * 8 + gpio_num)
      0x3D is for GPIO7_5

config  HI_GPIO_PCIE_POWER_EN_SUPPORT
    bool "Config GPIO for PCIe POWER EN"
    default n
    depends on HI_PCIE_SUPPORT

config  HI_GPIO_PCIE_POWER_EN
    hex "PCIe POWER EN(REG ON) GPIO Number"
    default 0xff
    depends on HI_GPIO_PCIE_POWER_EN_SUPPORT
    help
      pcie power en gpio
      gpio_pin (gpio_pin = gpio_group * 8 + gpio_num)
      0x2E is for GPIO5_6

endmenu
```

## scripts/kconfig/Kconfig.board.recoveryctrl
```kconfig
config HI_RECOVERY_GPIO
    hex  "Recovery Control Gpio"
    depends on ANDROID_PRODUCT
    default 0x10
    help
      LongPressing recovery buttom will into recovery system.
      the list of chip recovery control gpio as follow:
      Hi3798MV100
        recovery buttom is gpio2_0

      Hi3798CV200
        DMB  recovery buttom is gpio7_1
        DMC  recovery buttom is gpio6_5
        DMD  recovery buttom is gpio6_5

      Hi3798MV200
        recovery buttom is gpio8_6

      Hi3796mv200
        recovery bottom is gpio13_7
```

## scripts/kconfig/Kconfig.board.videodac
```kconfig
#+++++++++++++++++++++++++++++++++++++++++++++++++++
menu "Video DAC Config"

config HI_DAC_CVBS
    int "CVBS"
    range 0 5
    depends on !HI_NVR_SUPPORT
    help
        DAC number used as CVBS.

choice
    prompt "CVBS Circuit Type"
    default HI_VO_VDAC_VIDEO_BUFFER

config  HI_VO_VDAC_LC_CIRCUIT
    bool "LC"

config  HI_VO_VDAC_VIDEO_BUFFER
    bool "Video Buffer"

endchoice

config HI_YPBPR_SUPPORT
	bool "YPBPR Support"
    depends on HI3716MV410 || HI3716MV420 || HI3796MV200
	default y

config HI_DAC_YPBPR_Y
    int "YPBPR_Y"
    range 0 5
    depends on HI_YPBPR_SUPPORT
    help
        DAC number used as YPBPR_Y.

config HI_DAC_YPBPR_PB
    int "YPBPR_PB"
    range 0 5
    depends on HI_YPBPR_SUPPORT
    help
        DAC number used as YPBPR_PB.

config HI_DAC_YPBPR_PR
    int "YPBPR_PR"
    range 0 5
    depends on HI_YPBPR_SUPPORT
    help
        DAC number used as YPBPR_PR.

choice
    prompt "YPBPR Circuit Type"
    depends on HI_YPBPR_SUPPORT
    default HI_VO_YPBPR_VDAC_VIDEO_BUFFER

config  HI_VO_YPBPR_VDAC_LC_CIRCUIT
    bool "LC"

config  HI_VO_YPBPR_VDAC_VIDEO_BUFFER
    bool "Video Buffer"

endchoice

endmenu
#+++++++++++++++++++++++++++++++++++++++++++++++++++
```

## scripts/kconfig/Kconfig.demux
```kconfig
#+++++++++++++++++++++++++++++++++++++++++++++++++++
menu "DEMUX Config"
	depends on !HI_NVR_SUPPORT

config HI_DEMUX_SUPPORT
	bool
	default y

config HI_DEMUX_POOLBUF_SIZE
	hex "DEMUX Poolbuf Size"
	depends on HI_DEMUX_SUPPORT
	default 0x200000
	help
	    Configure section, pes and post channel memory.


endmenu
#+++++++++++++++++++++++++++++++++++++++++++++++++++
```

## scripts/kconfig/Kconfig.frontend.dvb_c
```kconfig
menu "DVB-C Demod Config"
    depends on HI_DVBC_SUPPORT

config  HI_DEMOD_TYPE_X5HDV2QAM
    bool "HI3130_INSIDE Support"
    depends on HI3716MV410 || HI3716MV420 || HI3796MV200
    default y

config  HI_DEMOD_TYPE_HI3130
    bool "HI3130_OUTSIDE Support"
    default y
    select HI_GPIOI2C_SUPPORT

config  HI_DEMOD_TYPE_J83B
    bool "J83B Support"
    default y
    select HI_GPIOI2C_SUPPORT

config  HI_DEMOD_TYPE_MXL254
    bool "MXL254 Support"
    default n
    select HI_GPIOI2C_SUPPORT

config  HI_DEMOD_TYPE_MXL214
    bool "MXL214 Support"
    default n
    select HI_GPIOI2C_SUPPORT

config  HI_DEMOD_TYPE_TDA18280
    bool "TDA18280 Support"
    default n
    select HI_GPIOI2C_SUPPORT

config  HI_DEMOD_TYPE_HI3138
    bool "HI3138 Support"
    default y
    select HI_GPIOI2C_SUPPORT
config  HI_DEMOD_TYPE_MXL251
    bool "MXL251 Support"
    default n
    select HI_GPIOI2C_SUPPORT    
endmenu

menu "DVB-C Tuner Config"
    depends on HI_DVBC_SUPPORT

config  HI_TUNER_TYPE_TDA18250
    bool "TDA18250 Support"
    default y

config  HI_TUNER_TYPE_TDA18250B
    bool "TDA18250B Support"
    default y

config  HI_TUNER_TYPE_MXL254
    bool "MXL254 Support"
    default n

config  HI_TUNER_TYPE_MXL214
    bool "MXL214 Support"
    default n

config  HI_TUNER_TYPE_TDA18280
    bool "TDA18280 Support"
    default n

config  HI_TUNER_TYPE_MXL203
    bool "MXL203 Support"
    default n

config  HI_TUNER_TYPE_MXL603
    bool "MXL603 Support"
    default n

config  HI_TUNER_TYPE_R820C
    bool "R820C Support"
    default n

config  HI_TUNER_TYPE_si2147
    bool "si2147 Support"
    default y

config  HI_TUNER_TYPE_MXL608
    bool "MXL608 Support"
    default y

config  HI_TUNER_TYPE_RAFAEL836
    bool "Rafael836 Support"
    default y
    
config  HI_TUNER_TYPE_R850
    bool "R850 Support"
    default y

config  HI_TUNER_TYPE_TDA182I5A
    bool "TDA182I5A Support"
    default n

config  HI_TUNER_TYPE_SI2144
    bool "SI2144 Support"
    default n
    
config  HI_TUNER_TYPE_MXL251
    bool "MXL251 Support"
    default n    
        
config  HI_TUNER_TYPE_R858
    bool "R858 Support"
    default n

endmenu
```

## scripts/kconfig/Kconfig.gstreamer
```kconfig
#+++++++++++++++++++++++++++++++++++++++++++++++++++
menuconfig GSTREAMER_SUPPORT
	bool "Gstreamer Support"
#	depends on HAL_SUPPORT && HI_AUDIO_OMX_SUPPORT
	depends on HI_AUDIO_OMX_SUPPORT
	default n
config  GSTREAMER_FULL_SUPPORT
	bool "Gstreamer Full Support"
	depends on GSTREAMER_SUPPORT
	default n
#+++++++++++++++++++++++++++++++++++++++++++++++++++
```

## scripts/kconfig/Kconfig.karaoke
```kconfig
#+++++++++++++++++++++++++++++++++++++++++++++++++++

config HI_KARAOKE_SUPPORT
	bool "KARAOKE Support"
	depends on ANDROID_PRODUCT
	default y

#+++++++++++++++++++++++++++++++++++++++++++++++++++
```

## scripts/kconfig/Kconfig.kernel
```kconfig
#+++++++++++++++++++++++++++++++++++++++++++++++++++
choice
    prompt "Kernel Version"
    default LINUX-4.4.y

config  LINUX-3.18.y
    bool "linux-3.18.y"

config  LINUX-4.4.y
    bool "linux-4.4.y"
endchoice

config  HI_KERNEL_VERSION
    string
    default linux-3.18.y if LINUX-3.18.y
    default linux-4.4.y if LINUX-4.4.y

config  HI_KERNEL_CFG
    prompt "Kernel Config File"
    string
    help
      Input config file for kernel. Such as xxxxx_defconfig.
      Config files are located in kernel source: arch/arm/configs.

#---------------------------------------------
config  HI_FS_BUILDIN
    bool "Build Rootfs in Kernel"
    default n
    help
      Say y to build rootfs in kernel.
#---------------------------------------------
config  HI_MSP_BUILDIN
    bool "Build MSP in Kernel"
    default n
    help
      Say y to build MSP modules in kernel.

#+++++++++++++++++++++++++++++++++++++++++++++++++++
```

## scripts/kconfig/Kconfig.mce
```kconfig
config  HI_MCE_SUPPORT
    bool "MCE Support"
    depends on HI_MSP_BUILDIN
    default n

config  HI_GRADUAL_VOLUME_SUPPORT
    bool "Gradual Volume Support"
    depends on  HI_MCE_SUPPORT && (HI3798MV200 || HI3798MV300 || HI3798MV200_A || HI3796MV200)
    default n
```

## scripts/kconfig/Kconfig.ntfs
```kconfig
menuconfig HI_NTFS_SUPPORT
	bool "NTFS Support"
	default n

config  HI_NTFS_TOOLS_SUPPORT
	bool "NTFS Tools Support"
	depends on HI_NTFS_SUPPORT
	default y
```

## scripts/kconfig/Kconfig.plcipher
```kconfig
#+++++++++++++++++++++++++++++++++++++++++++++++++++
#menu "PLCIPHER Config"
config HI_PLCIPHER_SUPPORT
	bool "PLCipher support"
	depends on HI3796MV200  || ((HI3716MV410 || HI3716MV420) && ADVCA_NAGRA )
	default y

#+++++++++++++++++++++++++++++++++++++++++++++++++++
```

## scripts/kconfig/Kconfig.qt
```kconfig
config HI_QT_SUPPORT
	bool "Qt Support"
    depends on HI_32BIT_SYSTEM
	default n
	help
      If you want to compile Qt in SDK, Select this option.
      Attention: You need to download Qt sourcecode and it's dependend softwares first. they are not included in SDK package default.
                 Please read relative document for more details.

#------------------------------------------------
choice

    prompt "Qt Version"
    depends on HI_QT_SUPPORT
    default HI_QT_5.5.0_SUPPORT

config  HI_QT_VERSION_5.5.1
    bool "Qt Version 5.5.1"
    help 
       If you want to choose Qt 5.5.1 version support, Select this option.

config  HI_QT_VERSION_5.7.0
    bool "Qt Version 5.7.0"
    help 
       If you want to choose Qt 5.7.0 version support, Select this option.

endchoice

choice

    prompt "Graphic Device"
    depends on HI_QT_SUPPORT
    default HI_QT_LINUXFB_SUPPORT

config  HI_QT_LINUXFB_SUPPORT
    bool "LinuxFB"
    help 
       If you want to choose LinuxFB as graphic device, Select this option.

config  HI_QT_EGL_SUPPORT
    depends on HI_GPU_SUPPORT
    bool "EGL"
    help 
       If you want to choose EGL as graphic device, Select this option.
       It depends on GPU support.

endchoice
```
